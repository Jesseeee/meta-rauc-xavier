## conf/distro/xavier-raucdemo.conf
```bitbake
DISTRO = "xavier-raucdemo"
DISTRO_NAME = "Xavier rauc distro"
DISTRO_VERSION_BASE = "4.2"
DISTRO_VERSION = "${DISTRO_VERSION_BASE}+snapshot-${METADATA_REVISION}"
DISTRO_CODENAME = "master"
SDK_VENDOR = "-sdk"
SDK_VERSION := "${@'${DISTRO_VERSION}'.replace('snapshot-${METADATA_REVISION}','snapshot')}"
SDK_VERSION[vardepvalue] = "${SDK_VERSION}"

MAINTAINER = "Jesse Van Gavere <jesseevg@gmail.com>"

TARGET_VENDOR = "-xavierrauc"

XAVIER_DEFAULT_DISTRO_FEATURES = "\
        largefile \
        systemd \
        opengl \
        wayland \
        rauc \
"

DISTRO_FEATURES ?= "${DISTRO_FEATURES_DEFAULT} ${XAVIER_DEFAULT_DISTRO_FEATURES}"

INIT_MANAGER ?= "systemd"

OVERLAYFS_ETC_INIT_TEMPLATE = "${COREBASE}/../meta-rauc-xavier/files/overlayfs-etc-preinit.sh.in"
OVERLAYFS_ETC_MOUNT_POINT = "/data"
OVERLAYFS_ETC_DEVICE = "/dev/mmcblk0p3"
OVERLAYFS_ETC_FSTYPE ?= "ext4"
OVERLAYFS_ETC_EXPOSE_LOWER = "true"
```

## conf/layer.conf
```bitbake
# We have a conf and classes directory, add to BBPATH
BBPATH .= ":${LAYERDIR}"

# We have recipes-* directories, add to BBFILES
BBFILES += "${LAYERDIR}/recipes-*/*/*.bb \
            ${LAYERDIR}/recipes-*/*/*.bbappend"

BBFILE_COLLECTIONS += "meta-rauc-xavier"
BBFILE_PATTERN_meta-rauc-xavier = "^${LAYERDIR}/"
BBFILE_PRIORITY_meta-rauc-xavier = "6"

LAYERDEPENDS_meta-rauc-xavier = "core"
LAYERSERIES_COMPAT_meta-rauc-xavier = "mickledore"
```

## conf/machine/xavier-rauc.conf
```bitbake
#@TYPE: Machine
#@NAME: Scioteq RNC based on Nvidia Jetson Xavier
#@DESCRIPTION: Scioteq RNC

require conf/machine/jetson-agx-xavier-devkit.conf

PARTITION_LAYOUT_TEMPLATE = "flash_t194_sdmmc_rootfs_ab_data.xml"
# 5G rootfs (2X)
ROOTFSPART_SIZE = "5368709120"
# 18G data
DATA_SIZE = "19327352832"

KERNEL_ARGS:append = " panic=10"

TNSPEC_MACHINE = "xavier-rauc-jetson-agx-xavier-devkit"
```
